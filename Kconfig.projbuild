## Kconfig.projbuild
```kconfig
menu "wyEspAgentPay"

    config WY_FIBER_RPC_URL
        string "Fiber RPC URL"
        default "http://192.168.1.10:8227"
        help
            URL of the fnn (Fiber Network Node) JSON-RPC endpoint.
            Example: http://192.168.68.105:8227
            Populate from NVS at runtime for production deployments.

    config WY_PAYMENT_TIMEOUT_MS
        int "Payment settlement timeout (ms)"
        default 30000
        range 5000 120000
        help
            Maximum time to wait for a Fiber payment to settle.
            30 seconds is reasonable for testnet. Increase for mainnet.

    config WY_HTTP_TIMEOUT_MS
        int "HTTP request timeout (ms)"
        default 10000
        range 2000 60000
        help
            Timeout for individual HTTP requests (not including payment time).

endmenu
```

## example/main/Kconfig.projbuild
```kconfig
menu "Example Configuration"

    config EXAMPLE_WIFI_SSID
        string "WiFi SSID"
        default "your_ssid"
        help
            SSID (network name) for the WiFi network to connect to.

    config EXAMPLE_WIFI_PASS
        string "WiFi Password"
        default "your_password"
        help
            WiFi password (WPA/WPA2/WPA3).

    config EXAMPLE_FIBER_RPC_URL
        string "Fiber RPC URL"
        default "http://192.168.68.105:8227"
        help
            URL of the Fiber Network node RPC endpoint.

    config EXAMPLE_TARGET_URL
        string "Target URL"
        default "http://httpbin.org/status/402"
        help
            URL to test HTTP 402 payment flow.

endmenu
```
